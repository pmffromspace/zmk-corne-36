## config/west.yml
```yaml
manifest:
  remotes:
    - name: zmkfirmware
      url-base: https://github.com/zmkfirmware
    # Additional modules containing boards/shields/custom code can be listed here as well
    # See https://docs.zephyrproject.org/3.2.0/develop/west/manifest.html#projects
    - name: m165437 #new entry
      url-base: https://github.com/M165437 #ANIMATIONS
  projects:
    - name: zmk
      remote: zmkfirmware
      revision: main
      import: app/west.yml
    - name: nice-view-gem #ANIMATIONS
      remote: m165437 #ANIMATIONS
      revision: main #ANIMATIONS
  self:
    path: config
```
